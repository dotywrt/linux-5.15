// SPDX-License-Identifier: GPL-2.0-or-later OR MIT

/dts-v1/;

#include "ipq8074.dtsi"
#include "ipq8074-hk-cpu.dtsi"
#include "ipq8074-ess.dtsi"
#include <dt-bindings/gpio/gpio.h>
#include <dt-bindings/input/input.h>

/ {
	model = "Sagemcom Fast 5866T";
	compatible = "sagemcom,5866t", "qcom,ipq8074";

	aliases {
		led-boot = &led_power;
		led-failsafe = &led_power;
		led-running = &led_power;
		led-upgrade = &led_power;
		serial0 = &blsp1_uart5;
		ethernet1 = &dp4;
		ethernet2 = &dp5;
		ethernet3 = &dp6_syn;
		label-mac-device = &dp4;
	};

	chosen {
		stdout-path = "serial0:115200n8"; 
	};
};
